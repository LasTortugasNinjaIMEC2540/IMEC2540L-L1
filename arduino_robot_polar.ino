#include <Servo.h>
#include <stdlib.h>
#include <ctype.h>
#include <math.h>

// ============================================================
// PARTE 1 - DATOS TRAYECTORIA
// Se copian los datos obtenidos tras el procesamiento del Google Colab en el entorno
// ============================================================

const char *csvData = R"CSV(
servo1,servo2
34.449792,57.883597
35.308403,58.591353
36.186076,59.284117
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34.953783,58.843453
)CSV";

// ============================================================
// Parte 2 - Configuración Electrónica
// Se configuran las variables asociadas al trabajo en una tarjeta ESP8266, y dos servos MG995
// ============================================================

#define PIN_SERVO_1 D2
#define PIN_SERVO_2 D1

Servo servo1;
Servo servo2;

// Los valores obtenidos a continuación corresponden al DataSheet del servo MG995
const int MIN_PULSE_US = 500;   // Ancho de pulso correspondiente a 0°
const int MAX_PULSE_US = 2500;   // Ancho de pulso correspondiente a 180°

const unsigned long DELAY_ENTRE_PASOS_MS = 500;
const int MAX_FILAS = 250;

float theta1[MAX_FILAS];
float theta2[MAX_FILAS];
int totalFilas = 0;

const int BUFFER_SIZE = 12000;
char bufferCSV[BUFFER_SIZE];

// ============================================================
// Parte 3 - Procesamiento de datos
// El siguiente bloque de código corresponde al procesamiento que debe realizar Arduino para trabajar los datos del CSV de la Parte 1
// ============================================================

void parsearCSV(const char *data) {
  totalFilas = 0;
  strncpy(bufferCSV, data, BUFFER_SIZE - 1);
  bufferCSV[BUFFER_SIZE - 1] = '\0';

  char *linea = strtok(bufferCSV, "\n\r");

  while (linea != NULL && totalFilas < MAX_FILAS) {
    while (*linea == ' ' || *linea == '\t') {
      linea++;
    }

    if (strlen(linea) > 0) {
      char *coma = strchr(linea, ',');
      if (coma != NULL) {
        char valor1[20];
        char valor2[20];
        int len1 = coma - linea;

        if (len1 < sizeof(valor1)) {
          strncpy(valor1, linea, len1);
          valor1[len1] = '\0';

          strncpy(valor2, coma + 1, sizeof(valor2) - 1);
          valor2[sizeof(valor2) - 1] = '\0';

          bool esNumero1 = isdigit(valor1[0]) || (valor1[0] == '-' && isdigit(valor1[1]));
          bool esNumero2 = isdigit(valor2[0]) || (valor2[0] == '-' && isdigit(valor2[1]));

          if (esNumero1 && esNumero2) {
            theta1[totalFilas] = atof(valor1);
            theta2[totalFilas] = atof(valor2);
            totalFilas++;
          }
        }
      }
    }
    linea = strtok(NULL, "\n\r");
  }
}

// ============================================================
// Parte 4 - Función Setup y Loop
// Finalmente, se configura como tal el funcionamiento de ambos servos (setup lo configura y loop le da el conjunto de instrucciones a seguir)
// ============================================================

void setup() {
  Serial.begin(115200);
  delay(500);

  parsearCSV(csvData);


  // Vincular los servos restringidos al rango de microsegundos configurado
  servo1.attach(PIN_SERVO_1, MIN_PULSE_US, MAX_PULSE_US);
  servo2.attach(PIN_SERVO_2, MIN_PULSE_US, MAX_PULSE_US);

  delay(1000);
}

void loop() {
  if (totalFilas == 0) {
    delay(2000);
    return;
  }

  for (int i = 0; i < totalFilas; i++) {
    float angulo1 = theta1[i];
    float angulo2 = theta2[i];

    servo1.write(angulo1);
    servo2.write(angulo2+50); // Se aplica un desfase al segundo servo para tomar en cuenta la referencia desde la cual el servo toma su 0


    delay(DELAY_ENTRE_PASOS_MS);
  }

  while (true) {
    yield(); // Mantiene estable el watchdog del ESP8266
    delay(1000);
  }
}